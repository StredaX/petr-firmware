## tests/app_core/testcase.yaml
```yaml
tests:
  firmware.app_core:
    platform_allow:
      - nrf9161dk/nrf9161/ns
      - native_sim
    integration_platforms:
      - nrf9161dk/nrf9161/ns
    tags:
      - app
      - unit
```
